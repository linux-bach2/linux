## Documentation/devicetree/bindings/display/hisilicon/hisilicon,hi6250-dpe.yaml
```yaml
# SPDX-License-Identifier: (GPL-2.0-only OR BSD-2-Clause)
%YAML 1.2
---
$id: http://devicetree.org/schemas/display/hisilicon/hisilicon,hi6250-dpe.yaml#
$schema: http://devicetree.org/meta-schemas/core.yaml#

title: HiSilicon Hi6250 display subsystem (DSS), bootloader-initialized pipeline

maintainers:
  - linux-bach2 <linux-bach2@users.noreply.github.com>

description:
  The display subsystem of the Hi6250 (Kirin 659). The bootloader powers it,
  sets up DSI and the panel and leaves the online pipeline (read channel D0,
  overlay 0, LDI0) scanning out a reserved buffer. This binding describes that
  running pipeline only; power, clocks, resets and the panel stay with the
  bootloader and are not described.

properties:
  compatible:
    const: hisilicon,hi6250-dpe

  reg:
    maxItems: 1

  interrupts:
    items:
      - description: PDP interrupt (ITF0 VSYNC, underflow)

  hisilicon,crg-syscon:
    $ref: /schemas/types.yaml#/definitions/phandle
    description: CRG syscon, read to check that the DSS is clocked and powered

  memory-region:
    items:
      - description: CMA pool for scanout buffers (shared-dma-pool, reusable)
      - description: the buffer the bootloader scans out

  memory-region-names:
    items:
      - const: pool
      - const: boot

required:
  - compatible
  - reg
  - interrupts
  - hisilicon,crg-syscon
  - memory-region
  - memory-region-names

additionalProperties: false

examples:
  - |
    #include <dt-bindings/interrupt-controller/arm-gic.h>

    display-controller@e8600000 {
        compatible = "hisilicon,hi6250-dpe";
        reg = <0xe8600000 0x80000>;
        interrupts = <GIC_SPI 245 IRQ_TYPE_LEVEL_HIGH>;
        hisilicon,crg-syscon = <&crg_ctrl>;
        memory-region = <&kms_pool>, <&logo_buffer>;
        memory-region-names = "pool", "boot";
    };
```

## Documentation/devicetree/bindings/media/hisilicon,hi6250-vdec.yaml
```yaml
# SPDX-License-Identifier: (GPL-2.0-only OR BSD-2-Clause)
%YAML 1.2
---
$id: http://devicetree.org/schemas/media/hisilicon,hi6250-vdec.yaml#
$schema: http://devicetree.org/meta-schemas/core.yaml#

title: HiSilicon Hi6250 video decoder (Imagination PVDEC D5500)

maintainers:
  - linux-bach2 <linux-bach2@users.noreply.github.com>

description:
  The Hi6250 (Kirin 659) video decoder is an Imagination PowerVR PVDEC (VXD, DDK "D5500")
  with an MTX co-processor that runs a firmware loaded by the host, and its own MMU. Its
  power (the vcodec subsystem and the vdec MTCMOS domain), clocks and resets are switched
  through CRG registers and a NOC idle handshake in the power management controller.

properties:
  compatible:
    const: hisilicon,hi6250-vdec

  reg:
    maxItems: 1

  interrupts:
    maxItems: 1

  hisilicon,crg-syscon:
    $ref: /schemas/types.yaml#/definitions/phandle
    description: the CRG (clock and reset generator) syscon

  hisilicon,pmctrl-syscon:
    $ref: /schemas/types.yaml#/definitions/phandle
    description: the power management controller syscon (NOC power idle registers)

  firmware-name:
    maxItems: 1
    description: MTX firmware file, default pvdec_full_bin.fw

required:
  - compatible
  - reg
  - interrupts
  - hisilicon,crg-syscon
  - hisilicon,pmctrl-syscon

additionalProperties: false

examples:
  - |
    #include <dt-bindings/interrupt-controller/arm-gic.h>
    video-codec@e8800000 {
        compatible = "hisilicon,hi6250-vdec";
        reg = <0xe8800000 0x100000>;
        interrupts = <GIC_SPI 257 IRQ_TYPE_LEVEL_HIGH>;
        hisilicon,crg-syscon = <&crg_ctrl>;
        hisilicon,pmctrl-syscon = <&pmctrl>;
    };
```

## Documentation/devicetree/bindings/power/hisilicon,hi6250-lpm3-pd.yaml
```yaml
# SPDX-License-Identifier: (GPL-2.0-only OR BSD-2-Clause)
%YAML 1.2
---
$id: http://devicetree.org/schemas/power/hisilicon,hi6250-lpm3-pd.yaml#
$schema: http://devicetree.org/meta-schemas/core.yaml#

title: HiSilicon Hi6250 power domains switched by the LPM3 firmware

maintainers:
  - linux-bach2 <linux-bach2@users.noreply.github.com>

description:
  On the Hi6250 (Kirin 659) some power domains, such as the Mali GPU (G3D), are
  switched by the LPM3 power management firmware on request over an IPC
  mailbox. The power state is read back from the CRG.

properties:
  compatible:
    const: hisilicon,hi6250-lpm3-pd

  "#power-domain-cells":
    const: 1

  mboxes:
    maxItems: 1
    description: The IPC mailbox to LPM3 that takes the power requests.

  hisilicon,crg-syscon:
    $ref: /schemas/types.yaml#/definitions/phandle
    description: The CRG (peripheral clock and reset generator) syscon.

required:
  - compatible
  - "#power-domain-cells"
  - mboxes
  - hisilicon,crg-syscon

additionalProperties: false

examples:
  - |
    power-controller {
        compatible = "hisilicon,hi6250-lpm3-pd";
        hisilicon,crg-syscon = <&crg_ctrl>;
        mboxes = <&mailbox 14 3 1>;
        #power-domain-cells = <1>;
    };
```

## drivers/gpu/drm/hisilicon/hi6250/Kconfig
```kconfig
# SPDX-License-Identifier: GPL-2.0-only
config DRM_HI6250_KMS
	tristate "HiSilicon Hi6250 DSS (adopt the bootloader pipeline)"
	depends on DRM && OF && MMU
	depends on ARCH_HISI || COMPILE_TEST
	select DRM_CLIENT_SELECTION
	select DRM_GEM_DMA_HELPER
	select DRM_KMS_HELPER
	select MFD_SYSCON
	help
	  KMS driver for the display subsystem of the HiSilicon Hi6250 (Kirin 659)
	  that takes over the pipeline the bootloader left running (DSI, panel and
	  clocks stay as they are) and adds page flips on the bootloader's layer,
	  vblank events and dumb buffers. The DRM driver is named "kirin", so Mesa
	  pairs it with a render-only GPU (panfrost) through kmsro.

	  If in doubt, say N.
```

## drivers/media/platform/imagination/Kconfig
```kconfig
# SPDX-License-Identifier: GPL-2.0
config VIDEO_E5010_JPEG_ENC
	tristate "Imagination E5010 JPEG Encoder Driver"
	depends on VIDEO_DEV
	depends on ARCH_K3 || COMPILE_TEST
	select VIDEOBUF2_DMA_CONTIG
	select VIDEOBUF2_VMALLOC
	select V4L2_MEM2MEM_DEV
	select V4L2_JPEG_HELPER
	help
	  This is a video4linux2 M2M driver for Imagination E5010 JPEG encoder,
	  which supports JPEG and MJPEG baseline encoding of YUV422 and YUV420
	  semiplanar video formats, with resolution ranging from 64x64 to 8K x 8K
	  pixels. The module will be named as e5010_jpeg_enc.

config VIDEO_IMG_VXD_DEC
	tristate "Imagination VXD (PVDEC D5500/D5520) video decoder"
	depends on VIDEO_DEV
	depends on V4L_MEM2MEM_DRIVERS
	depends on ARCH_HISI || ARCH_K3 || COMPILE_TEST
	depends on ARM64
	depends on MFD_SYSCON
	select VIDEOBUF2_DMA_CONTIG
	select VIDEOBUF2_DMA_SG
	select V4L2_MEM2MEM_DEV
	help
	  Stateful V4L2 mem2mem driver for the Imagination PowerVR video
	  decoder (PVDEC/VXD), with the bitstream header parser in the
	  kernel. Derived from TI's vxd-dec (D5520); supports the HiSilicon
	  Hi6250 PVDEC (D5500) with its stock MTX firmware
	  (pvdec_full_bin.fw, not distributed). The module is vxd-dec.
```

## drivers/net/wireless/hi1102/Kconfig
```kconfig
config HI1102_SDIO
	tristate "HiSilicon Hi1102 SDIO bootstrap (experimental)"
	depends on MMC
	select FW_LOADER
	help
	  Initial Hi1102 transport bring-up. Enables function 1, checks the
	  boot ROM VERSION reply and uploads the stock Wi-Fi firmware.
	  A wireless network interface is not implemented yet.
```

## drivers/pmdomain/hisilicon/Kconfig
```kconfig
# SPDX-License-Identifier: GPL-2.0-only
menu "HiSilicon PM Domains"

config HI6250_LPM3_PD
	bool "HiSilicon Hi6250 LPM3 power domains"
	depends on ARCH_HISI || COMPILE_TEST
	depends on MAILBOX && OF
	select PM_GENERIC_DOMAINS
	select MFD_SYSCON
	help
	  Power domains of the Hi6250 (Kirin 659) that only the LPM3 power
	  management firmware can switch, such as the Mali GPU (G3D). The
	  driver sends the stock on/off words on LPM3 IPC mailbox 14 and
	  reads the isolation, reset and clock state back from the CRG.

	  Mailbox 14 can have only one client: this driver cannot be used
	  together with another one that holds it.

endmenu
```
